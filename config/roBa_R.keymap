#include "roBa_L.keymap"

#include "boards/shields/Test/roBa_R.overlay"
&trackball {
    automouse-layer = <MOUSE>;
    scroll-layers = <SCROLL>;
    // snipe-layers = <3>;

    arrows {
        layers = <3>;
        bindings =
            <&kp RIGHT_ARROW>,
            <&kp LEFT_ARROW>,
            <&kp UP_ARROW>,
            <&kp DOWN_ARROW>;

        tick = <10>;
        wait-ms = <5>;
        tap-ms = <5>;
    };

    volume {
        layers = <2>;
        bindings =
                <&none>,
                <&none>,
                <&kp C_VOLUME_UP>,
                <&kp C_VOLUME_DOWN>;

        wait-ms = <5>;
        tap-ms = <5>;
    };
};
